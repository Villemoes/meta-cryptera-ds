## conf/layer.conf
```bitbake
BBPATH .= ":${LAYERDIR}"

BBFILES += " \
    ${LAYERDIR}/recipes-*/*/*.bb \
    ${LAYERDIR}/recipes-*/*/*.bbappend \
"

BBFILE_COLLECTIONS += "cryptera"
BBFILE_PATTERN_cryptera := "^${LAYERDIR}/"
BBFILE_PRIORITY_cryptera = "20"

LAYERSERIES_COMPAT_cryptera = "scarthgap"
# Compatibility setting for scarthgap only.
UNPACKDIR ??= "${WORKDIR}"

LAYERDEPENDS_cryptera = "core openembedded-layer"

LICENSE_PATH += "${LAYERDIR}/licenses"

# Allow use of python functions implemented in lib/cryptera/ .
addpylib ${LAYERDIR}/lib cryptera
```
